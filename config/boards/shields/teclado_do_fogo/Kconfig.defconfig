## config/boards/shields/teclado_do_fogo/Kconfig.defconfig
```kconfig
if SHIELD_TECLADO_DO_FOGO_LEFT

config ZMK_KEYBOARD_NAME
    default "Teclado do Fogo"

config ZMK_SPLIT_ROLE_CENTRAL
    default y

endif

if SHIELD_TECLADO_DO_FOGO_LEFT || SHIELD_TECLADO_DO_FOGO_RIGHT

config ZMK_SPLIT
    default y

endif
```

## config/boards/shields/teclado_do_fogo/Kconfig.shield
```kconfig
config SHIELD_TECLADO_DO_FOGO_LEFT
    def_bool $(shields_list_contains,teclado_do_fogo_left)

config SHIELD_TECLADO_DO_FOGO_RIGHT
    def_bool $(shields_list_contains,teclado_do_fogo_right)
```
